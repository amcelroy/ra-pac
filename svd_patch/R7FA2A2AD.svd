# R7FA2A2AD register map
Vendor: Renesas Electronics Corporation; Series: RA2A2; File version: 1.20.02
Arm Cortex,M23 based Microcontroller RA2A2 group
CPU: CM23 r1p0, little endian, MPU, no FPU, VTOR, 2 interrupt priority bits, 32 interrupts
Registers are 8-bit, read-write, reset 0x0 unless marked. A register's access mark holds for its fields unless they carry their own. Offsets are from the block's base; lines under a group give offsets from that group; [hi:lo] are bit positions; {n}, {i} and the like mark numbered series; 'fields as' and 'values as' point back to an identical list; <NAME> marks a mode.

## Memory map
0x40000000 RMPU blocks up to offset 0xD20 — Renesas Memory Protection Unit
0x40001000 MMF size 0x8 — Memory Mirror Function
0x40002000 SRAM blocks up to offset 0xD9 — SRAM Control
0x40003000 BUS blocks up to offset 0x1835 — BUS Control
0x40005400 DTC blocks up to offset 0x10 — Data Transfer Controller
0x40006000 ICU blocks up to offset 0x410 — ICU for CPU
0x4001B000 DBG blocks up to offset 0x14 — Debug Function
0x4001E000 SYSC blocks up to offset 0x4CC — System Control
0x40040000 PORT0 size 0xC — Port 0 Control Registers
0x40040020 PORT1 size 0x10 — Port 1 Control Registers
0x40040040 PORT2 size 0x10 — Port 2 Control Registers
0x40040060 PORT3 size 0xC — Port 3 Control Registers
0x40040080 PORT4 size 0xC — Port 4 Control Registers
0x400400A0 PORT5 size 0xC — Port 5 Control Registers
0x400400C0 PORT6 size 0xC — Port 6 Control Registers
0x40040800 PFS blocks up to offset 0x510 — Pmn Pin Function Control Register
0x40041000 ELC blocks up to offset 0x50 — Event Link Controller
0x40042000 POEG blocks up to offset 0x104 — Port Output Enable Module for GPT
0x40044000 RTC blocks up to offset 0x8C — Realtime Clock
0x40044200 WDT blocks up to offset 0x9 — Watchdog Timer
0x40044400 IWDT blocks up to offset 0x6 — Independent Watchdog Timer
0x40044600 CAC blocks up to offset 0xC — Clock Frequency Accuracy Measurement Circuit
0x40047000 MSTP size 0xE — Module Stop Control A, B, C, D
0x40053000 IIC0 size 0x14 — Inter,Integrated Circuit 0
0x40053014 IIC0WU blocks up to offset 0x4 — Inter,Integrated Circuit 0 Wake,up Unit
0x40053100 IIC1 size 0x14 — Inter,Integrated Circuit 1
0x40054100 DOC blocks up to offset 0x6 — Data Operation Circuit
0x4005C000 ADC120 blocks up to offset 0xE4 — 12-bit A/D Converter
0x40070000 SCI0 size 0x1D — Serial Communication Interface 0
0x40070020 SCI1 blocks up to offset 0x1D — Serial Communication Interface 1
0x40070040 SCI2 blocks up to offset 0x1D — Serial Communication Interface 2
0x40070060 SCI3 blocks up to offset 0x1D — Serial Communication Interface 3
0x40070120 SCI9 blocks up to offset 0x1D — Serial Communication Interface 9
0x40072000 SPI0 blocks up to offset 0x12 — Serial Peripheral Interface
0x40074000 CRC blocks up to offset 0xE — Cyclic Redundancy Check Calculator
0x40078400 GPT164 blocks up to offset 0x90 — General PWM 16-bit Timer 4
0x40078500 GPT165 blocks up to offset 0x90 — General PWM 16-bit Timer 5
0x40078600 GPT166 blocks up to offset 0x90 — General PWM 16-bit Timer 6
0x40078700 GPT167 blocks up to offset 0x90 — General PWM 16-bit Timer 7
0x40078800 GPT168 blocks up to offset 0x90 — General PWM 16-bit Timer 8
0x40078900 GPT169 blocks up to offset 0x90 — General PWM 16-bit Timer 9
0x40078FF0 GPT_OPS size 0x4 — Output Phase Switching Controller
0x40082000 SLCDC blocks up to offset 0x12D — Segment LCD Controller
0x40084000 AGTW0 size 0x13 — Low Power Asynchronous General Purpose Timer 0
0x40084100 AGTW1 size 0x13 — Low Power Asynchronous General Purpose Timer 1
{0x40084200+0x100*n} AGT{n} blocks up to offset 0x10 (n=0..7) — Low Power Asynchronous General Purpose Timer {n}
0x4009C000 SDADC24_B blocks up to offset 0xF0 — 24-Bit Sigma,Delta A/D Converter B
0x400A0000 MACL blocks up to offset 0x198 — 32-bit Multiply,Accumulator
0x407EC000 FLCN blocks up to offset 0x3FD6 — Flash I/O Registers

## Interrupts
{n} IEL{n} (ICU) (n=0..31) — ICU Interrupt {n}

## Licence text in the file
This software is supplied by Renesas Electronics Corporation and is only intended for use with Renesas products. No other uses are authorized. This software is owned by. Renesas Electronics Corporation and is protected under all applicable laws, including copyright laws. . THIS SOFTWARE IS PROVIDED "AS IS" AND RENESAS MAKES NO WARRANTIES REGARDING. THIS SOFTWARE, WHETHER EXPRESS, IMPLIED OR STATUTORY, INCLUDING BUT NOT LIMITED TO. WARRANTIES OF MERCHANTABILITY, FITNESS FOR A PARTICULAR PURPOSE AND NON-INFRINGEMENT. ALL SUCH WARRANTIES ARE EXPRESSLY DISCLAIMED. TO THE MAXIMUM EXTENT PERMITTED NOT. PROHIBITED BY LAW, NEITHER RENESAS ELECTRONICS CORPORATION NOR ANY OF ITS AFFILIATED. COMPANIES SHALL BE LIABLE FOR ANY DIRECT, INDIRECT, SPECIAL, INCIDENTAL OR CONSEQUENTIAL. DAMAGES FOR ANY REASON RELATED TO THIS SOFTWARE, EVEN IF RENESAS OR ITS AFFILIATES HAVE. BEEN ADVISED OF THE POSSIBILITY OF SUCH DAMAGES. . Renesas reserves the right, without notice, to make changes to this software and to discontinue the availability of this software. By using this software, you agree to the additional terms and conditions found by accessing the following link: http://www.renesas.com/disclaimer
